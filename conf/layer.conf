## conf/layer.conf
```bitbake
# We have a conf and classes directory, add to BBPATH
BBPATH .= ":${LAYERDIR}"

# We have recipes-* directories, add to BBFILES
BBFILES += "${LAYERDIR}/recipes-*/*/*.bb \
	${LAYERDIR}/recipes-*/*/*.bbappend"

BBFILE_COLLECTIONS += "neuralnetwork"

BBFILE_PATTERN_neuralnetwork = "^${LAYERDIR}/"
BBFILE_PRIORITY_neuralnetwork = "7"
LAYERVERSION_neuralnetwork = "6"
LAYERSERIES_COMPAT_neuralnetwork = "kirkstone langdale mickledore"
```
